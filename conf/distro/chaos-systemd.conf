## conf/distro/chaos-systemd.conf
```bitbake
# Add chaos flavor
require conf/distro/include/chaos.inc

# Systemd please
DISTRO_FEATURES_append = " systemd virtualization"
VIRTUAL-RUNTIME_init_manager = "systemd"
DISTRO_FEATURES_BACKFILL_CONSIDERED = "sysvinit"
```

## conf/layer.conf
```bitbake
# We have a conf and classes directory, add to BBPATH
BBPATH .= ":${LAYERDIR}"

# We have recipes-* directories, add to BBFILES
BBFILES += "${LAYERDIR}/recipes-*/*/*.bb \
            ${LAYERDIR}/recipes-*/*/*.bbappend"

BBFILE_COLLECTIONS += "chaos-layer"
BBFILE_PATTERN_chaos-layer = "^${LAYERDIR}/"
BBFILE_PRIORITY_chaos-layer = "6"

# Additional license directories
LICENSE_PATH += " ${LAYERDIR}/files/custom-licenses"

LAYERDEPENDS_chaos-layer += " rust-layer"

LAYERSERIES_COMPAT_chaos-layer = "dunfell gatesgarth hardknott"
```

## conf/local.conf.sample
```bitbake
# Machine Selection
#MACHINE ?= "raspberrypi"
#MACHINE ?= "raspberrypi2"
MACHINE ?= "raspberrypi3"
#MACHINE ?= "raspberrypi3-64"
# MACHINE ?= "qemuarm"

# Parallesim Options
BB_NUMBER_THREADS ?= "${@oe.utils.cpu_count()}"
PARALLEL_MAKE ?= "-j ${@oe.utils.cpu_count()}"

# Where to place downloads
DL_DIR ?= "${TOPDIR}/downloads"

# Where to place shared-state files
SSTATE_DIR ?= "${TOPDIR}/sstate-cache"

# Where to place the build output
TMPDIR = "${TOPDIR}/tmp"

# Default policy config
DISTRO ?= "chaos-systemd"

# Additional image features
USER_CLASSES ?= "buildstats image-mklibs image-prelink"

# By default disable interactive patch resolution (tasks will just fail instead):
PATCHRESOLVE = "noop"

#
# Disk Space Monitoring during the build
#
# Monitor the disk space during the build. If there is less that 1GB of space or less
# than 100K inodes in any key build location (TMPDIR, DL_DIR, SSTATE_DIR), gracefully
# shutdown the build. If there is less that 100MB or 1K inodes, perform a hard abort
# of the build. The reason for this is that running completely out of space can corrupt
# files and damages the build in ways which may not be easily recoverable.
# It's necesary to monitor /tmp, if there is no space left the build will fail
# with very exotic errors.
BB_DISKMON_DIRS ??= "\
    STOPTASKS,${TMPDIR},1G,100K \
    STOPTASKS,${DL_DIR},1G,100K \
    STOPTASKS,${SSTATE_DIR},1G,100K \
    STOPTASKS,/tmp,100M,100K \
    ABORT,${TMPDIR},100M,1K \
    ABORT,${DL_DIR},100M,1K \
    ABORT,${SSTATE_DIR},100M,1K \
    ABORT,/tmp,10M,1K"


# Qemu configuration
PACKAGECONFIG_append_pn-qemu-native = " sdl"
PACKAGECONFIG_append_pn-nativesdk-qemu = " sdl"

# CONF_VERSION is increased each time build/conf/ changes incompatibly and is used to
# track the version of this file when it was generated. This can safely be ignored if
# this doesn't mean anything to you.
CONF_VERSION = "1"

DEVELOPMENT_IMAGE = "1"
ENABLE_UART = "1"

CONNECTIVITY_CHECK_URIS=""
```

## meta-chaos-common/conf/layer.conf
```bitbake
# We have a conf and classes directory, add to BBPATH
BBPATH .= ":${LAYERDIR}"

# We have recipes-* directories, add to BBFILES
BBFILES += "${LAYERDIR}/recipes-*/*/*.bb \
            ${LAYERDIR}/recipes-*/*/*.bbappend"

BBFILE_COLLECTIONS += "meta-chaos-common"
BBFILE_PATTERN_meta-chaos-common = "^${LAYERDIR}/"
BBFILE_PRIORITY_meta-chaos-common = "6"

LAYERSERIES_COMPAT_meta-chaos-common = "rocko sumo"
```

## meta-chaos-core/conf/distro/include/chaos.inc
```bitbake
# Poky based distro file
require conf/distro/poky.conf

DISTRO = "chaos"
DISTRO_NAME = "CHAOS"
DISTRO_VERSION = "1.0.0"
HOSTOS_VERSION = "${DISTRO_VERSION}"
MAINTAINER = "Murat Kilivan <murat.kilivan@gmail.com>"

# Strip down unneeded features
POKY_DEFAULT_DISTRO_FEATURES_remove = "ptest"
POKY_DEFAULT_DISTRO_FEATURES_remove = "wayland"
DISTRO_FEATURES_DEFAULT_remove = "x11"

# Development image mode
DEVELOPMENT_IMAGE ?= "0"
DISTRO_FEATURES_append = " ${@bb.utils.contains('DEVELOPMENT_IMAGE','1','development-image','',d)}"

# Providers
PREFERRED_PROVIDER_docker ?= "docker"
PREFERRED_PROVIDER_jpeg ?= "jpeg"
PREFERRED_PROVIDER_jpeg-native ?= "jpeg-native"

# defaults to ipk packages
PACKAGE_CLASSES ?= "package_ipk"

BAD_RECOMMENDATIONS += "shared-mime-info"
```

## meta-chaos-qemu/conf/layer.conf
```bitbake
# We have a conf and classes directory, add to BBPATH
BBPATH .= ":${LAYERDIR}"

# We have recipes-* directories, add to BBFILES
BBFILES += "${LAYERDIR}/recipes-*/*/*.bb \
            ${LAYERDIR}/recipes-*/*/*.bbappend"

BBFILE_COLLECTIONS += "meta-chaos-qemu"
BBFILE_PATTERN_meta-chaos-qemu = "^${LAYERDIR}/"
BBFILE_PRIORITY_meta-chaos-qemu = "6"

LAYERDEPENDS_meta-chaos-qemu = "core"
LAYERSERIES_COMPAT_meta-chaos-qemu = "dunfell"
```

## meta-chaos-raspberrypi/conf/layer.conf
```bitbake
# We have a conf and classes directory, add to BBPATH
BBPATH .= ":${LAYERDIR}"

# We have recipes-* directories, add to BBFILES
BBFILES += "${LAYERDIR}/recipes-*/*/*.bb \
            ${LAYERDIR}/recipes-*/*/*.bbappend"

BBFILE_COLLECTIONS += "chaos-raspberrypi-layer"
BBFILE_PATTERN_chaos-raspberrypi-layer = "^${LAYERDIR}/"
BBFILE_PRIORITY_chaos-raspberrypi-layer = "6"

LAYERDEPENDS_chaos-raspberrypi-layer = "raspberrypi"
LAYERSERIES_COMPAT_chaos-raspberrypi-layer = "dunfell"
```

## meta-chaos-warrior/conf/layer.conf
```bitbake
# We have a conf and classes directory, add to BBPATH
BBPATH .= ":${LAYERDIR}"

# We have recipes-* directories, add to BBFILES
BBFILES += "${LAYERDIR}/recipes-*/*/*.bb \
            ${LAYERDIR}/recipes-*/*/*.bbappend"

BBFILE_COLLECTIONS += "meta-chaos-warrior"
BBFILE_PATTERN_meta-chaos-warrior = "^${LAYERDIR}/"
BBFILE_PRIORITY_meta-chaos-warrior = "6"

LAYERDEPENDS_meta-chaos-warrior = "core"
LAYERSERIES_COMPAT_meta-chaos-warrior = "warrior"
```
